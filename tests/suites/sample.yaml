## tests/suites/sample.yaml
```yaml
# End-to-end suite for fixtures/sample-extension.
# Run with: pikabo run tests/suites/sample.yaml --ext fixtures/sample-extension

name: sample extension

after:
  - clearStorage

tests:
  - name: popup counts clicks and persists them
    steps:
      - openPopup
      # The popup hydrates from storage asynchronously; without this the click below can be
      # undone by the initial render resolving a few milliseconds later.
      - waitFor: "body[data-ready]"
      - assertText:
          selector: "#count"
          equals: "0"
      - click: "#bump"
      - waitForText:
          selector: "#status"
          text: Counted.
      - assertText:
          selector: "#count"
          equals: "1"
      - assertStorage:
          key: clickCount
          equals: 1
      - screenshot: after-first-click
      - click: "#bump"
      - assertStorage:
          key: clickCount
          equals: 2
      - assertNoConsoleErrors

  - name: popup downloads a file and records it
    steps:
      - openPopup
      - waitFor: "body[data-ready]"
      - click: "#save"
      - waitForDownload: "*.txt"
      - assertDownload:
          pattern: sample-report.txt
          minBytes: 10
      - assertStorage:
          key: lastSave
          equals: sample-report.txt

  # chrome.downloads.download() from the service worker never surfaces as a page download event.
  # This is the case that page-level automation cannot see at all.
  - name: a file saved by the service worker is still captured
    steps:
      - openPopup
      - eval:
          # A block scalar, because a bare `{` starts a YAML flow mapping.
          script: |
            return await chrome.runtime.sendMessage({ type: 'saveFromWorker' });
          in: popup
      - waitForDownload:
          pattern: worker-report.txt
          timeout: 20000
      - assertFile:
          pattern: worker-report.txt
          minBytes: 20
          contains: generated by the sample extension service worker

  - name: options page saves settings
    steps:
      - openOptions
      - waitFor: "body[data-ready]"
      - select:
          selector: "#theme"
          value: dark
      - fill:
          selector: "#label"
          value: My label
      - click: "#save-options"
      - waitForText:
          selector: "#saved"
          text: Options saved
      - assertStorage:
          key: theme
          equals: dark
      - assertStorage:
          key: label
          equals: My label
      - screenshot: options-saved

  - name: content script injects a banner on example.com
    steps:
      - navigate: https://example.com/
      - waitForExtensionEvent:
          type: contentScript.executed
          contains:
            url: example.com
      - waitFor: "#pikabo-banner"
      - assertText:
          selector: "#pikabo-banner"
          contains: pikabo sample
      - eval:
          script: document.documentElement.dataset.pikabo
      - expect:
          equals: injected

  # Chrome does not deliver sendMessage back to the sender's own context, so the message has to
  # originate somewhere other than the worker itself.
  - name: service worker answers messages from the popup
    steps:
      - openPopup
      - eval:
          script: |
            const response = await chrome.runtime.sendMessage({ type: 'ping' });
            return response.type;
          in: popup
      - waitForExtensionEvent:
          type: runtime.message
          contains:
            message:
              type: ping
      - expect:
          equals: pong

  - name: storage can be seeded and read back
    steps:
      - setStorage:
          key: seeded
          value:
            nested: true
            items: [1, 2, 3]
      - assertStorage:
          key: seeded
          equals:
            nested: true
            items: [1, 2, 3]
      - assertStorage:
          key: seeded
          contains:
            nested: true
      - clearStorage
      - assertStorage:
          key: seeded
          exists: false

  - name: declared permissions are actually held
    steps:
      - assertPermission: storage
      - assertPermission: downloads
      - assertPermission:
          permission: bookmarks
          not: true
```
